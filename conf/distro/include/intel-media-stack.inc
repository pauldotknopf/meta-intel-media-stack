## conf/distro/include/intel-media-stack.inc
```bitbake
MACHINE_HWCODECS_remove -= "va-intel gstreamer1.0-vaapi"
MACHINE_HWCODECS_append += "media-driver msdk gstreamer-msdk"

PNBLACKLIST[gstreamer1.0-vaapi] = "use gstreamer-msdk instead"
```

## conf/layer.conf
```bitbake
# We have a conf and classes directory, add to BBPATH
BBPATH .= ":${LAYERDIR}"

# We have recipes-* directories, add to BBFILES
BBFILES += "${LAYERDIR}/recipes-*/*/*.bb \
	${LAYERDIR}/recipes-*/*/*.bbappend"

BBFILE_COLLECTIONS += "meta-intel-media-stack"
BBFILE_PATTERN_meta-intel-media-stack = "^${LAYERDIR}/"
BBFILE_PRIORITY_meta-intel-media-stack = "6"

LINUX_MEDIA_SERVER_STUDIO_LOCATION = "https://github.com/pauldotknopf/meta-intel-media-stack/releases/download/2017_R3/intel-linux-media_generic_16.5.2-64009_64bit.tar.gz"

require conf/distro/include/intel-media-stack.inc
```
